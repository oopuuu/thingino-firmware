## package/thingino-libubox/Config.in
```kconfig
config BR2_PACKAGE_THINGINO_LIBUBOX
	bool "thingino-libubox"
	depends on !BR2_STATIC_LIBS
	select BR2_PACKAGE_LIBUBOX
	select BR2_PACKAGE_JSON_C
	help
	  Thingino override for libubox that ensures json-c support
	  and builds blobmsg_json and json_script libraries.

comment "thingino-libubox needs a toolchain w/ dynamic library"
	depends on BR2_STATIC_LIBS
```

## package/thingino-ustream-ssl/Config.in
```kconfig
config BR2_PACKAGE_THINGINO_USTREAM_SSL
	bool "thingino-ustream-ssl"
	select BR2_PACKAGE_USTREAM_SSL
	# Select mbedtls to prevent ustream-ssl from auto-selecting openssl
	# The override will replace mbedtls with wolfssl at build time
	select BR2_PACKAGE_MBEDTLS if !BR2_PACKAGE_WOLFSSL && !BR2_PACKAGE_THINGINO_WOLFSSL
	select BR2_PACKAGE_WOLFSSL if !BR2_PACKAGE_MBEDTLS
	help
	  Thingino override for ustream-ssl that configures the SSL backend
	  based on available SSL libraries (wolfSSL or mbedTLS).
	  When wolfssl is enabled, it will be used instead of openssl.
```
